## drivers/input/touchscreen/mediatek/Kconfig
```kconfig
#
# Touchscreen driver configuration
#
menuconfig INPUT_TOUCHSCREEN
	bool "Touchscreens"
	help
	  Say Y here, and a list of supported touchscreens will be displayed.
	  This option doesn't affect the kernel.

	  If unsure, say Y.

if INPUT_TOUCHSCREEN

config TOUCHSCREEN_MTK
	tristate "MediaTek Touch Panel Driver"
	default n
	help
	  Say Y here if you have MediaTek touch panel.

	  If unsure, say N.

	  To compile this dirver as a module, choose M here: the
	  module will be called.

config TOUCHSCREEN_MTK_GT1151
	bool "GT1151 for Mediatek package"
	default n
	help
	  Say Y here if you have GT1151 touch panel.

	  If unsure, say N.

	  To compile this dirver as a module, choose M here: the
	  module will be called.

source "drivers/input/touchscreen/mediatek/GT1151/Kconfig"

config TOUCHSCREEN_MTK_GT928
	tristate "GT928 Touchscreen"
	help
	  Say Y here if you have Goodix GT928 touchscreen,
	  connected to your system.
	  If unsure, say N.
	  To compile this driver as a module, choose M here.



config TOUCHSCREEN_MTK_SYNAPTICS_I2C_RMI4
	tristate "Synaptics DSX I2C touchscreen"
	depends on I2C
	help
	  Say Y here if you have a Synaptics DSX I2C touchscreen
	  connected to your system.

	  If unsure, say N.

	  To compile this driver as a module, choose M here: the
	  module will be called synaptics_i2c_rmi4.

source "drivers/input/touchscreen/mediatek/synaptics_i2c_rmi4/Kconfig"

config TOUCHSCREEN_MTK_GT910
	bool "GT910 for Mediatek package"
	default n
	help
	  Say Y here if you have GT910 touch panel.

	  If unsure, say N.

	  To compile this dirver as a module, choose M here: the
	  module will be called.

source "drivers/input/touchscreen/mediatek/GT910/Kconfig"

config TOUCHSCREEN_MTK_GT9XX_HOTKNOT_SCP
	bool "GT9XX_HOTKNOT_SCP for Mediatek package"
	default n
	help
	  Say Y here if you have GT9XX_HOTKNOT_SCP touch panel.

	  If unsure, say N.

	  To compile this dirver as a module, choose M here: the
	  module will be called.

#source "drivers/input/touchscreen/mediatek/GT9XX_hotknot_scp/Kconfig"

config TOUCHSCREEN_MTK_GT911
	bool "GT911 for Mediatek package"
	default n
	help
	  Say Y here if you have GT911 touch panel.

	  If unsure, say N.

	  To compile this dirver as a module, choose M here: the
	  module will be called.

#source "drivers/input/touchscreen/mediatek/GT911/Kconfig"

config TOUCHSCREEN_MTK_FT5X0X
	bool "FT5X0X for Mediatek package"
	default n
	help
	  Say Y here if you have FT5X0X touch panel.

	  If unsure, say N.

	  To compile this dirver as a module, choose M here: the
	  module will be called.

source "drivers/input/touchscreen/mediatek/ft5x0x/Kconfig"

config TOUCHSCREEN_MTK_SYNAPTICS_3320_50
	bool "Synaptics 5.0inch for Mediatek package"
    default n


config TOUCHSCREEN_MTK_FOCALTECH
	bool "FOCALTECH for Mediatek package"
	default n
	help
	  Say Y here if you have FOCALTECH touch panel.
	  If unsure, say N.
	  To compile this dirver as a module, choose M here: the
	  module will be called.
source "drivers/input/touchscreen/mediatek/focaltech/Kconfig"
config TOUCHSCREEN_UNIFIED_DRIVER_4
	bool "LGE Unified driver Ver4.0"
	depends on I2C
	default n
	help
	  Say Y here if you use lge unified driver ver4.0
	  if unsure, say N
	  To compile this dirver as a module, choose M here: the
	  module will be called.


config TOUCHSCREEN_MTK_GT9XX_V26
	bool "GT9XX V26 for Mediatek package"
	default n
	help
	  Say Y here if you have GT9XX V26 touch panel.
	  If unsure, say N.
	  To compile this dirver as a module, choose M here: the
	  module will be called.
source "drivers/input/touchscreen/mediatek/GT9XX_V26/Kconfig"

config TOUCHSCREEN_MTK_GT1X_V14
	bool "GT1X_V14 for Mediatek package"
	default n
	help
	  Say Y here if you have GT1X_V14 touch panel.
	  If unsure, say N.
	  To compile this dirver as a module, choose M here: the
	  module will be called.
source "drivers/input/touchscreen/mediatek/GT1X_V14/Kconfig"
config TOUCHSCREEN_MTK_GSL968
	bool "GSL968 for Mediatek package"
	default n
	help
	  Say Y here if you have GSL968 touch panel.
	  If unsure, say N.
	  To compile this dirver as a module, choose M here: the
	  module will be called.
#source "drivers/input/touchscreen/mediatek/GSL968/Kconfig"
config TOUCHSCREEN_MTK_MSG28XX
	bool "MSG28XX for Mediatek package"
	default n
	help
	  Say Y here if you have GT9XX V26 touch panel.
	  If unsure, say N.
	  To compile this dirver as a module, choose M here: the
	  module will be called.
#source "drivers/input/touchscreen/mediatek/msg28xx/Kconfig"
config TOUCHSCREEN_MTK_MSG2238
	bool "MSG2238 for Mediatek package"
	default n
	help
	  Say Y here if you have MSG2238 touch panel.
	  If unsure, say N.
	  To compile this dirver as a module, choose M here: the
	  module will be called.
#source "drivers/input/touchscreen/mediatek/msg2238/Kconfig"
config TOUCHSCREEN_MTK_MSG5846
	bool "MSG5846 for Mediatek package"
	default n
	help
	  Say Y here if you have MSG5846 touch panel.
	  If unsure, say N.
	  To compile this dirver as a module, choose M here: the
	  module will be called.
#source "drivers/input/touchscreen/mediatek/msg5846/Kconfig"
config TOUCHSCREEN_SYNAPTICS_3402
	bool "SYNAPTICS_3402 for Mediatek package"
	default n
	help
	  Say Y here if you have SYNAPTICS_3402 touch panel.
	  If unsure, say N.
	  To compile this dirver as a module, choose M here: the
	  module will be called.
source "drivers/input/touchscreen/mediatek/synaptics_3402/Kconfig"

config TOUCHSCREEN_MTK_LU2X3X
	bool "TOUCHSCREEN_LU2X3X for Mediatek package"
	default n

config TOUCHSCREEN_HIMAX_CHIPSET
	bool "Himax touchpanel CHIPSET"
	depends on I2C
	help
	  Say Y here if you have a Himax CHIPSET touchscreen.
	  HIMAX controllers are multi touch controllers which can
	  report 10 touches at a time.

          If unsure, say N.
source "drivers/input/touchscreen/mediatek/hxchipset/Kconfig"

config TOUCHSCREEN_MTK_MSG28XX
	bool "MSG28XX for Mediatek package"
	default n
	help
	  Say Y here if you have GT9XX V26 touch panel.
	  If unsure, say N.
	  To compile this dirver as a module, choose M here: the
	  module will be called.
source "drivers/input/touchscreen/mediatek/msg28xx/Kconfig"
endif
```

## drivers/input/touchscreen/mediatek/lu2x3x/Kconfig
```kconfig
#
# Touchscreen driver configuration
#


config LU2X3X_CONFIG
	string "lu2x3x for Mediatek config"
```

## drivers/misc/mediatek/accelerometer/bma255-new/Kconfig
```kconfig
config MTK_BMA255_NEW
	bool "BMA255_NEW for MediaTek package"
	default n
	help
	  It support different accelerometer sensor.
          If this option is set,
	  it will support
          BMA255_NEW Accelerometer.
```

## drivers/misc/mediatek/accelerometer/bmi160_acc/Kconfig
```kconfig
config MTK_BMI160_ACC
        bool "BMI160_ACC for MediaTek package"
        default n
```

## drivers/misc/mediatek/alsps/em3071X/Kconfig
```kconfig
config MTK_EM3071X
	bool "MTK_EM3071X for MediaTek package"
	default n
	help
	It support different type sensor
	in this platform. If this option
	is set, it will support ambient
	and light sensor MTK_EM3071X.
```

## drivers/misc/mediatek/fingerprint/Kconfig
```kconfig
config HCT_FINGERPRINT_SUPPORT
  bool "HCT_FINGERPRINT_SUPPORT"
  default n

source "drivers/misc/mediatek/fingerprint/cs15xx/Kconfig"
source "drivers/misc/mediatek/fingerprint/microarray_v4.0.01/Kconfig"
source "drivers/misc/mediatek/fingerprint/sunwavecorp/Kconfig"
source "drivers/misc/mediatek/fingerprint/gf_minanf_368_1214/Kconfig"
source "drivers/misc/mediatek/fingerprint/gf_gf5116m_1216/Kconfig"
source "drivers/misc/mediatek/fingerprint/afs120n/Kconfig"
source "drivers/misc/mediatek/fingerprint/cdfinger/Kconfig"
source "drivers/misc/mediatek/fingerprint/goodix_gf5216/Kconfig"
source "drivers/misc/mediatek/fingerprint/dfs747/Kconfig"
source "drivers/misc/mediatek/fingerprint/sunwavecorp_tee/Kconfig"
```

## drivers/misc/mediatek/fingerprint/cdfinger/Kconfig
```kconfig
config FINGERPRINT_CDFINGER
        bool "FINGERPRINT_CDFINGER"
        default n
```

## drivers/misc/mediatek/fingerprint/gf_gf5116m_1216/Kconfig
```kconfig
config FINGERPRINT_GF_GF5116M_1216
        bool "FINGERPRINT_GF_GF516M_1216"
        default n
```

## drivers/misc/mediatek/fingerprint/gf_minanf_368_1214/Kconfig
```kconfig
# Copyright (C) MicroArray  
# MicroArray Fprint Driver Code
# Kconfig
# Date: 2016-10-12
# Version: v4.0.01 
# Author: guq
# Contact: guq@microarray.com.cn

config FINGERPRINT_GF_MINANF_368_1214
        bool "FINGERPRINT_GF_MINANF_368_1214"
        default n
```

## drivers/misc/mediatek/fingerprint/goodix_gf5216/Kconfig
```kconfig
config FINGERPRINT_GOODIX_GF5216
        bool "FINGERPRINT_GOODIX_GF5216"
        default n
```

## drivers/misc/mediatek/fingerprint/microarray_v4.0.01/Kconfig
```kconfig
# Copyright (C) MicroArray  
# MicroArray Fprint Driver Code
# Kconfig
# Date: 2016-10-12
# Version: v4.0.01 
# Author: guq
# Contact: guq@microarray.com.cn

config FINGERPRINT_MICROARRAY
        bool "FINGERPRINT_MICROARRAY"
        default n
	
config FINGERPRINT_MICROARRAY_A80T
        bool "FINGERPRINT_MICROARRAY_A80T"
        default n

config FINGERPRINT_MICROARRAY_TEE
        bool "FINGERPRINT_MICROARRAY_TEE"
        default n

config FINGERPRINT_MICROARRAY_A80T_TEE
        bool "FINGERPRINT_MICROARRAY_A80TEE"
        default n
```

## drivers/misc/mediatek/fingerprint/sunwavecorp/Kconfig
```kconfig
config FINGERPRINT_SUNWAVECORP
        bool "FINGERPRINT_SUNWAVECORP"
        default n
```

## drivers/misc/mediatek/fingerprint/sunwavecorp_tee/Kconfig
```kconfig
config FINGERPRINT_SUNWAVECORP_TEE
        bool "FINGERPRINT_SUNWAVECORP"
        default n

config FINGERPRINT_SUNWAVE_TEE
        bool "FINGERPRINT_SUNWAVE"
        default n
```

## drivers/misc/mediatek/flashlight/Kconfig
```kconfig
config MTK_FLASHLIGHT
  bool CONFIG_MTK_FLASHLIGHT
  default n
  help
    CONFIG_MTK_FLASHLIGHT

config CUSTOM_KERNEL_FLASHLIGHT
        string "CUSTOM_KERNEL_FLASHLIGHT"
        help
          Kernel space cameara flashlight driver. You can use this driver
          choose cameara flashlight type.

config HCT_FLASHLIGHT
	string "HCT_FLASHLIGHT"

config HCT_FLASHLIGHT_SUB_SUPPORT
	bool CONFIG_HCT_FLASHLIGHT_SUB_SUPPORT
	default n

config HCT_FLASHLIGHT_SUB
	string "HCT_FLASHLIGHT_SUB"

source "drivers/misc/mediatek/flashlight/src/mt6755/Kconfig"
```

## drivers/misc/mediatek/flashlight/src/mt6755/Kconfig
```kconfig
config FLASHLIGHT_AW3641E
	bool CONFIG_FLASHLIGHT_AW3641E
	default n

config FLASHLIGHT_SGM3785
	bool FLASHLIGHT_SGM3785
	default n
	
config FLASHLIGHT_SUB_GPIO
	bool FLASHLIGHT_SUB_GPIO
	default n
	
config FLASHLIGHT_SUB_PWM
	bool FLASHLIGHT_SUB_PWM
	default n
	
	
```

## drivers/misc/mediatek/gyroscope/bmg160-new/Kconfig
```kconfig
config MTK_BMG160_NEW
        bool "BMG160_NEW for MediaTek package"
        default n
	help
        It support different gyroscope sensor.
        If this option is set,
	  	it will support
        BMG160_NEW gyroscope.
```

## drivers/misc/mediatek/magnetometer/bmm150-new/Kconfig
```kconfig
config MTK_BMM150_NEW
        bool "BMM150_NEW for Mediatek package"
        default n
	help
	  It support different magnetometer sensor.
          If this option is set,
	  it will support
          BMM150_NEW magnetometer.
```

## drivers/misc/mediatek/security_chip/Kconfig
```kconfig
config HCT_SECURITY_CHIP_SUPPORT
  bool "CONFIG_HCT_SECURITY_CHIP_SUPPORT"
  default n
```
